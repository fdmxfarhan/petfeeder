#include <Wire.h>
#include <Adafruit_GFX.h>
#include <Adafruit_SH110X.h>
#include <qrcode.h>
#include <ESP8266WiFi.h>
#include <ESP8266WebServer.h>
#include <WiFiUdp.h>
#include <NTPClient.h>
#include <SocketIoClient.h>  // Include Socket.IO client library


const int qrCodeVersion = 3;
const int pixelSize = 2;
const int buttonPin = 16;  // Pin where the push button is connected

const char* initial_ssid = "ESP-12";
const char* initial_password = "12341234";

// ---------------------- Web Pages:
String inputFormPage = R"rawliteral(
<!DOCTYPE HTML><html>
<head>
  <title>WiFi Configuration</title>
  <meta name="viewport" content="width=device-width, initial-scale=1">
  <style>
    body{
        margin: 0;
        padding: 0;
        font-family: 'Segoe UI', Tahoma, Geneva, Verdana, sans-serif;
        background-color: #282C38;
        color: white;
        text-align: center;
    }
    h1{
        font-size: 5vw;
        width: 80%;
        margin: 3vw auto;
        margin-top: 15vw;
        padding: 1vw 0;
        border-bottom: 0.6vw solid white;
    }
    p{
        font-size: 3.6vw;
        width: 80%;
        margin: 3vw auto;
        color: #c0c0c0;
    }
    .raw{
        margin-bottom: 3vw;
        width: 100%;
    }
    .raw .label{
        font-size: 4vw;
        padding: 1vw 0;
    }
    .raw input{
        font-family: 'Segoe UI', Tahoma, Geneva, Verdana, sans-serif;
        background-color: #3F4253;
        border: none;
        padding: 1vw 3vw;
        border-radius: 1vw;
        color: white;
        font-size: 5vw;
        text-align: center;
    }
    input.submit{
        font-family: 'Segoe UI', Tahoma, Geneva, Verdana, sans-serif;
        color: white;
        background-color: #4CC9F0;
        padding: 1vw 3vw;
        border-radius: 1vw;
        font-size: 5vw;
        border: none;
        margin-top: 5vw;
    }
    input.submit:hover{background-color: #F72585;}
  </style>
</head>
<body>
  <h1>Configure WiFi</h1>
  <p>please connect to a network that have access to the internet.</p>
  <form action="/connect" method="POST">
    <div class="raw">
        <div class="label">SSID: </div>
        <input type="text" name="ssid">
    </div>
    <div class="raw">
        <div class="label">Password: </div>
        <input type="text" name="password">
    </div>
    <input class="submit" type="submit" value="Submit">
  </form>
</body>
</html>
)rawliteral";

String htmlPage = R"rawliteral(
<!DOCTYPE HTML><html>
<head>
  <title>ESP8266 LED Control</title>
  <meta name="viewport" content="width=device-width, initial-scale=1">
</head>
<body>
  <h1>ESP8266 LED Control</h1>
  <p>LED State: %STATE%</p>
  <p><a href="/led/on"><button>Turn On</button></a></p>
  <p><a href="/led/off"><button>Turn Off</button></a></p>
</body>
</html>
)rawliteral";


// https://javl.github.io/image2cpp/
const unsigned char PROGMEM dog_bitmap[] = {
  0x00, 0x00, 0x00, 0x00, 0x00, 0x00, 0x00, 0x00, 0x00, 0x00, 0x00, 0x00, 0x00, 0x00, 0x00, 0x00, 
	0x00, 0x00, 0x00, 0x00, 0x00, 0x00, 0x00, 0x00, 0x00, 0x00, 0x00, 0x00, 0x00, 0x00, 0x00, 0x00, 
	0x00, 0x00, 0x00, 0x00, 0x00, 0x00, 0x00, 0x00, 0x00, 0x00, 0x00, 0x00, 0x00, 0x00, 0x00, 0x00, 
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	0x00, 0x00, 0x00, 0x00, 0x00, 0x00, 0x00, 0x00, 0x00, 0x00, 0x00, 0x00, 0x00, 0x00, 0x00, 0x00

  // Add more bytes here for your image, adjusted to fit 128x64 pixels
};

ESP8266WebServer server(80);
WiFiUDP ntpUDP;
NTPClient timeClient(ntpUDP, "pool.ntp.org", 0, 60000);  // UTC timezone (0 offset), 60-second update interval
Adafruit_SH1106G display = Adafruit_SH1106G(128, 64, &Wire, -1);

bool qrCodeDisplayed = false;  // Flag to track if the QR code has been displayed
IPAddress IP1;
IPAddress IP2;
const int ledPin = 2;
bool ledState = false;  // Variable to store the state of the LED
bool connected_to_net = false;
String new_ssid, new_password;

void showQRCode(String qrCodeString) {
  QRCode qrcode;
  uint8_t qrcodeBytes[qrcode_getBufferSize(qrCodeVersion)];
  qrcode_initText(&qrcode, qrcodeBytes, qrCodeVersion, ECC_LOW, qrCodeString.c_str());


  int startX = (128 - (qrcode.size * pixelSize) - (pixelSize * 2)) / 2 + 32;
  int startY = 0;
  int qrCodeSize = qrcode.size;

  display.fillRect(startX, startY, (qrCodeSize * pixelSize) + (pixelSize * 2), (qrCodeSize * pixelSize) + (pixelSize * 2), 1);

  for (uint8_t y = 0; y < qrCodeSize; y++) {
    for (uint8_t x = 0; x < qrCodeSize; x++) {
      if (qrcode_getModule(&qrcode, x, y)) {
        display.fillRect(x * pixelSize + startX + pixelSize, y * pixelSize + startY + pixelSize, pixelSize, pixelSize, 0);
      }
    }
  }
}
String processor(const String& var) {
  if (var == "STATE") {
    return ledState ? "ON" : "OFF";
  }
  return String();
}
void handleRoot() {
  if(!connected_to_net){
    server.send(200, "text/html", inputFormPage);
  }else{
    String page = htmlPage;
    page.replace("%STATE%", processor("STATE"));
    server.send(200, "text/html", page);
  }
}
void handleLedOn() {
  ledState = true;
  digitalWrite(ledPin, LOW);
  handleRoot();
}
void handleLedOff() {
  ledState = false;
  digitalWrite(ledPin, HIGH);
  handleRoot();
}
void handleConnect() {
  new_ssid = server.arg("ssid");
  new_password = server.arg("password");

  if (new_ssid.length() > 0 && new_password.length() > 0) {
    Serial.println("Connecting to new SSID: " + new_ssid);

    // Stop current AP
    WiFi.softAPdisconnect(true);
    WiFi.disconnect();

    // Connect to new WiFi network
    WiFi.begin(new_ssid.c_str(), new_password.c_str());

    int attempts = 0;
    display.clearDisplay();
    display.setCursor(0, 20);
    display.setTextSize(2);
    display.println("Connecting");
    display.display();
    while (WiFi.status() != WL_CONNECTED && attempts < 100) {
      display.print(".");
      display.display();
      
      digitalWrite(ledPin, HIGH);
      delay(300);
      digitalWrite(ledPin, LOW);
      delay(200);
      attempts++;
    }

    if (WiFi.status() == WL_CONNECTED) {
      IP2 = WiFi.localIP();
      connected_to_net = true;
      display.clearDisplay();
      display.setCursor(5, 20);
      display.setTextSize(2);
      display.println("Connected");
      display.setTextSize(1);
      display.println("http://" + IP2.toString());
      display.display();
      
      timeClient.begin();
      timeClient.setTimeOffset(12600);  // Set offset to UTC+3:30 (3 hours 30 minutes = 12600 seconds)
      timeClient.update();
      
      server.sendHeader("Location", "http://" + IP2.toString(), true);
      server.send(302, "text/plain", "redirecting");
      // Restart web server
      server.begin();
      delay(1000);
    } else {
      server.send(200, "text/html", "Failed to connect. Please try again.");
    }
  }
}
void setup() {
  Serial.begin(9600);
  pinMode(ledPin, OUTPUT);
  digitalWrite(ledPin, LOW);
  pinMode(buttonPin, INPUT_PULLUP);

  WiFi.softAP(initial_ssid, initial_password);
  IP1 = WiFi.softAPIP();

  server.on("/", HTTP_GET, handleRoot);
  server.on("/connect", HTTP_POST, handleConnect);
  server.on("/led/on", HTTP_GET, handleLedOn);
  server.on("/led/off", HTTP_GET, handleLedOff);
  server.begin();
  
  display.begin(0x3C, true);
  display.setTextSize(1);
  display.setTextColor(1);
  display.clearDisplay();
  display.drawBitmap(0, 0, dog_bitmap, 128, 64, 1);
  display.display();
  delay(3000);
}
void loop() {
  display.clearDisplay();
  server.handleClient();
  
  if(!connected_to_net){
    display.setCursor(0, 0);
    display.println("Connect:");
    display.println();
    display.println(initial_ssid);
    display.println();
    display.println(initial_password);
    display.println();
    display.println(timeClient.getFormattedTime());
    // display.setCursor(0, 56);
    // display.println(IP1.toString());
    showQRCode("http://" + IP1.toString());
  }else{
    display.setCursor(0, 0);
    display.println("Connected");
    display.println();
    display.println(new_ssid);
    display.println();
    display.println(timeClient.getFormattedTime());
    // display.setCursor(0, 56);
    // display.println(IP2.toString());
    showQRCode("http://" + IP2.toString());
  }
  
  if (digitalRead(buttonPin)) {
    qrCodeDisplayed = !qrCodeDisplayed;
    timeClient.update();
    while(digitalRead(buttonPin));
  }
  display.display();
}
